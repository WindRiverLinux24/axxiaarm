## conf/layer.conf
```bitbake
#
# Copyright (C) 2015 - 2021 Wind River Systems, Inc.
#

# We have a conf and classes directory, add to BBPATH
BBPATH =. "${LAYERDIR}:"

# We have a packages directory, add to BBFILES
BBFILES += "${LAYERDIR}/recipes-*/*/*.bb \
 	${LAYERDIR}/recipes-*/*/*.bbappend"

BBFILE_COLLECTIONS += "wr-axxiaarm"
BBFILE_PATTERN_wr-axxiaarm = "^${LAYERDIR}/"
BBFILE_PRIORITY_wr-axxiaarm = "7"

# This should only be incremented on significant changes that will
# cause compatibility issues with other layers
LAYERVERSION_wr-axxiaarm = "1"

LAYERDEPENDS_wr-axxiaarm = "core wrlinux"
LAYERSERIES_COMPAT_wr-axxiaarm = "wrl scarthgap"

WRL_RECIPES:wr-axxiaarm += 'atf-axxia u-boot-fw-utils'
```
